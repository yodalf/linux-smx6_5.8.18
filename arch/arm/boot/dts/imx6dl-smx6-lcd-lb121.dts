// SPDX-License-Identifier: (GPL-2.0+ OR MIT)
/*
 * Copyright 2020 Kontron Europe GmbH
 */

/dts-v1/;

#define SMX6_PANEL_LCD
#define SMX6_PANEL_18BIT

#define SMX6_SSI1_AUDIO
#define SMX6_SSI1_AUDIO_OUTPUT 0

#define SMX6_SERIAL_CAMERA
#define SMX6_SERIAL_CAMERA_ENDPOINT ov5640_to_mipi_csi2
#define SMX6_SERIAL_CAMERA_DATA_LANES 1 2
#define SMX6_SERIAL_CAMERA_CLOCK_LANES 0

#include "../imx6dl-kontron-samx6i.dtsi"
#include "imx6qdl-smx6.dtsi"
#include "kontron-smarc-evaluation-carrier.dtsi"
#include "smx6-ov5640-camera.dtsi"

&lcd_panel_timings { // LB121S03
	clock-frequency = <38500000>;
	hactive = <800>;
	vactive = <600>;
	hback-porch = <88>;
	hfront-porch = <72>;
	vback-porch = <15>;
	vfront-porch = <4>;
	hsync-len = <64>;
	vsync-len = <6>;
};

&ldb {
	status = "disabled";
};
