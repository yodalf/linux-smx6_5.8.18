// SPDX-License-Identifier: (GPL-2.0+ OR MIT)
/*
 * Copyright 2020 Kontron Europe GmbH
 */

/dts-v1/;

#define SMX6_PANEL_LCD
#define SMX6_PANEL_18BIT

#define SMX6_SSI1_AUDIO
#define SMX6_SSI1_AUDIO_OUTPUT 0

#define SMX6_SERIAL_CAMERA
#define SMX6_SERIAL_CAMERA_ENDPOINT ov5640_to_mipi_csi2
#define SMX6_SERIAL_CAMERA_DATA_LANES 1 2
#define SMX6_SERIAL_CAMERA_CLOCK_LANES 0

#define smarc_sata sata

#include "../imx6q-kontron-samx6i.dtsi"
#include "imx6qdl-smx6.dtsi"
#include "kontron-smarc-evaluation-carrier.dtsi"
#include "smx6-ov5640-camera.dtsi"

&lcd_panel_timings { // PM070WL4
	clock-frequency = <22000000>;
	hactive = <800>;
	vactive = <480>;
	hback-porch = <86>;
	hfront-porch = <42>;
	vback-porch = <33>;
	vfront-porch = <10>;
	hsync-len = <128>;
	vsync-len = <2>;
};

&ldb {
	status = "disabled";
};
